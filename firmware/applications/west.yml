## firmware/applications/west.yml
```yaml
manifest:
  self:
    path: applications
    west-commands: scripts/west-commands.yml
  defaults:
    remote: zephyrproject
  remotes:
    - name: zephyrproject
      url-base: https://github.com/zephyrproject-rtos
  projects:
    - name: zephyr
      remote: zephyrproject
      revision: v4.3.0
      import: true
```

## firmware/boards/vendor/awohali_h745/Kconfig.awohali_h745
```kconfig
# Awohali_H745 board configuration

# SPDX-License-Identifier: Apache-2.0

config BOARD_AWOHALI_H745
	select SOC_STM32H745XX_M7 if BOARD_AWOHALI_H745_STM32H745XX_M7
	select SOC_STM32H745XX_M4 if BOARD_AWOHALI_H745_STM32H745XX_M4
```

## firmware/boards/vendor/awohali_h745/Kconfig.defconfig
```kconfig
# Awohali_H745 board configuration

# SPDX-License-Identifier: Apache-2.0

if BOARD_AWOHALI_H745

# Mailbox is required for inter-core communication on both cores
config MBOX
    default y

if BOARD_AWOHALI_H745_STM32H745XX_M4

config UART_CONSOLE
	default n

endif # BOARD_AWOHALI_H745_STM32H745XX_M4

endif # BOARD_AWOHALI_H745
```

## firmware/boards/vendor/awohali_h745/awohali_h745_m4_defconfig
```kconfig
# SPDX-License-Identifier: Apache-2.0
# Copyright (c) 2026 Madison Gleydura <deepspace00@pm.me>

# Enable GPIO
CONFIG_GPIO=y

# Enable UART
CONFIG_SERIAL=y

# Enable I2C
CONFIG_I2C=y

# Enable CAN
CONFIG_CAN=y

# Enable SPI
CONFIG_SPI=y

# Enable clock control
CONFIG_CLOCK_CONTROL=y

# Config Mailbox
CONFIG_MBOX=y
```

## firmware/boards/vendor/awohali_h745/awohali_h745_stm32h745xx_m4_defconfig
```kconfig
# SPDX-License-Identifier: Apache-2.0
# Copyright (c) 2020 Alexander Kozhinov <ak.alexander.kozhinov@gmail.com>
# Copyright (c) 2024 Tomas Jurena <jurena@utb.cz>

# Enable GPIO
CONFIG_GPIO=y

# Enable UART
CONFIG_SERIAL=y

# Enable I2C
CONFIG_I2C=y

# Enable CAN
CONFIG_CAN=y

# Enable SPI
CONFIG_SPI=y

# Enable clock control
CONFIG_CLOCK_CONTROL=y

# Config Mailbox
CONFIG_MBOX=y
```

## firmware/boards/vendor/awohali_l433/Kconfig.awohali_l433
```kconfig
# Awohali_L433 board configuration

# SPDX-License-Identifier: Apache-2.0

config BOARD_AWOHALI_L433
    bool
    select SOC_STM32L433XX
```

## firmware/boards/vendor/awohali_l433/awohali_l433_defconfig
```kconfig
# SPDX-License-Identifier: Apache-2.0
# Copyright (c) 2026 Madison Gleydura <deepspace00@pm.me>

# Enable MPU
CONFIG_ARM_MPU=y

# Enable GPIO
CONFIG_GPIO=y

# Enable I2C
CONFIG_I2C=y

# Enable CAN
CONFIG_CAN=y

# Enable SPI
CONFIG_SPI=y

# Enable clock control
CONFIG_CLOCK_CONTROL=y

# Console
CONFIG_CONSOLE=y

# Enable USB
CONFIG_USB_DEVICE_STACK=y
CONFIG_USB_CDC_ACM=y
CONFIG_UART_LINE_CTRL=y
CONFIG_USB_DEVICE_INITIALIZE_AT_BOOT=y
CONFIG_CDC_ACM_DTE_RATE_CALLBACK_SUPPORT=y

# USB enumeration settings
CONFIG_USB_DEVICE_VID=0x1209
CONFIG_USB_DEVICE_PID=0x0001
CONFIG_USB_DEVICE_MANUFACTURER="DeepSpace Engineering"
CONFIG_USB_DEVICE_PRODUCT="Awohali"
CONFIG_USB_DEVICE_SN="0001"
```

## firmware/boards/vendor/awohali_l433/dts/bindings/charger/ti,bq25798.yaml
```yaml
# SPDX-License-Identifier: Apache-2.0
# Copyright (c) 2026 Madison Gleydura <deepspace00@pm.me>

description: TI BQ25798 Buck-Boost Battery Charger

compatible: "ti,bq25798"

include: [battery.yaml, i2c-device.yaml]

properties:
  reg:
    required: true
    description: I2C address, default 0x6B

  re-charge-threshold:
    type: string
    enum:
      - "15_PERCENT"
      - "62.5_PERCENT"
      - "66.7_PERCENT"
      - "71.4_PERCENT"
    description: Battery voltage threshold for percentage to fast charge transistion

  cell-count:
    type: int
    required: true
    enum:
      - 1
      - 2
      - 3
      - 4
    description: Battery series cell count

  constant-charge-current-max-microamp:
    type: int
    required: true
    description: Maximum charge current in microamps

  constant-charge-voltage-max-microvolt:
    type: int
    required: true
    description: Maximum charge voltage in microvolts

  input-voltage-max-microvolt:
    type: int
    description: Maximum input voltage limit (VINDPM) in microvolts

  input-current-max-microamp:
    type: int
    description: Maximum input current limit in microamps

  precharge-current-microamp:
    type: int
    description: Current for pre-charge phase in microamps

  charge-term-microamp:
    type: int
    description: Current for charge termination phase in microamps

  int-gpios:
    type: phandle-array
    description: Interrupt GPIO from the BQ25798 INT pin

  ce-gpios:
    type: phandle-array
    description: Charge enable GPIO pin

  qon-gpios:
    type: phandle-array
    description: Ship FET enable or system power reset control GPIO pin
```

## firmware/boards/vendor/awohali_l433/dts/bindings/fuel-gauge/ti,bq76905.yaml
```yaml
description: TI BQ76905 5-Series Battery Monitor and Protector

compatible: "ti,bq76905"

include:
  - i2c-device.yaml
  - fuel-gauge.yaml   # if it exists, inherit standard properties

properties:
  reg:
    required: true

  alert-gpios:
    type: phandle-array
    description: Alert/interrupt output from BQ76905

  cell-count:
    type: int
    required: true
    description: Number of cells in series (1-5 for BQ76905)

  enable-alarm:
    type: boolean
    description: Enable status alarm

  enable-charge-fet:
    type: boolean
    description: Enable/disable charge FET

  enable-discharge-fet:
    type: boolean
    description: Enable/disable discharge FET

  overvoltage-threshold-microvolt:
    type: int
    description: Per-cell overvoltage protection threshold in microvolts

  undervoltage-threshold-microvolt:
    type: int
    description: Per-cell undervoltage protection threshold in microvolts

  overcurrent-threshold-microamp:
    type: int
    description: Discharge overcurrent protection threshold in microamps

  short-circuit-threshold-microamp:
    type: int
    description: Short circuit protection threshold in microamps

  balancing-enable:
    type: boolean
    description: Enable passive cell balancing
```

## firmware/boards/vendor/awohali_stm32h745zi/Kconfig.awohali_stm32h745zi
```kconfig
# Awohali_STM32H745ZI board configuration

# SPDX-License-Identifier: Apache-2.0

config BOARD_AWOHALI_STM32H745ZI
	select SOC_STM32H745XX_M7 if BOARD_AWOHALI_STM32H745ZI_STM32H745XX_M7
	select SOC_STM32H745XX_M4 if BOARD_AWOHALI_STM32H745ZI_STM32H745XX_M4
```

## firmware/boards/vendor/awohali_stm32h745zi/Kconfig.defconfig
```kconfig
# Awohali_STM32H745ZI board configuration

# SPDX-License-Identifier: Apache-2.0

if BOARD_AWOHALI_STM32H745ZI

# Mailbox is required for inter-core communication on both cores
config MBOX
    default y

endif # BOARD_AWOHALI_STM32H745ZI
```

## firmware/boards/vendor/awohali_stm32h745zi/awohali_stm32h745zi_m7_defconfig
```kconfig
# SPDX-License-Identifier: Apache-2.0
# Copyright (c) 2026 Madison Gleydura <deepspace00@pm.me>

# Enable MPU
CONFIG_ARM_MPU=y

# Enable HW stack protection
CONFIG_HW_STACK_PROTECTION=y

# Enable flash
CONFIG_FLASH=y
CONFIG_FLASH_STM32_QSPI=y

# Enable UART
CONFIG_SERIAL=y
CONFIG_UART_LINE_CTRL=y

# Console
CONFIG_CONSOLE=y
CONFIG_UART_CONSOLE=y

# Enable GPIO
CONFIG_GPIO=y

# Enable USB
CONFIG_USB_DEVICE_STACK=y
CONFIG_USB_DEVICE_INITIALIZE_AT_BOOT=y
CONFIG_CDC_ACM_DTE_RATE_CALLBACK_SUPPORT=y

# Enable SDMMC
CONFIG_SDMMC_STM32=y
CONFIG_DISK_DRIVER_SDMMC=y
CONFIG_FILE_SYSTEM=y
CONFIG_FAT_FILESYSTEM_ELM=y
CONFIG_DISK_ACCESS=y

# Enable Ethernet
CONFIG_NET_L2_ETHERNET=y
CONFIG_ETH_STM32_HAL=y
CONFIG_PHY_GENERIC_MII=n

# Networking Stack
CONFIG_NETWORKING=y
CONFIG_NET_IPV4=y
CONFIG_NET_IPV6=n
CONFIG_NET_TCP=y
CONFIG_NET_UDP=y
CONFIG_NET_SOCKETS=y

# Network Buffers
CONFIG_NET_PKT_RX_COUNT=16
CONFIG_NET_PKT_TX_COUNT=16
CONFIG_NET_BUF_RX_COUNT=64
CONFIG_NET_BUF_TX_COUNT=64

# Entropy (RNG)
CONFIG_ENTROPY_STM32_RNG=y

# Config Mailbox
CONFIG_MBOX=y
```

## firmware/boards/vendor/awohali_stm32h745zi/board.yml
```yaml
board:
  name: awohali_stm32h745zi
  vendor: vendor
  socs:
    - name: stm32h745xx
```

## firmware/boards/vendor/awohali_stm32h745zi/dts/bindings/usb/microchip,usb2422.yaml
```yaml
# SPDX-License-Identifier: Apache-2.0

description: Microchip USB2422 USB 2.0 Hi-Speed 2-Port Hub Controller

compatible: "microchip,usb2422"

include: i2c-device.yaml   # pulls in reg, status, and base I2C properties

properties:
  reg:
    required: true

  reset-gpios:
    type: phandle-array
    description: |
      GPIO connected to the RESET_N pin of the USB2422.
      Active low.

  vbus-supply:
    type: phandle
    description: |
      Regulator supplying VBUS to the downstream ports.

  max-current-ma:
    type: int
    default: 500
    description: |
      Maximum current in mA provided per downstream port.
      Per USB2422 datasheet, valid values are 100 or 500.

  self-powered:
    type: boolean
    description: |
      Set if the hub is self-powered. If absent, bus-powered
      is assumed.
```

## firmware/boards/vendor/awohali_stm32l433cc/Kconfig.awohali_stm32l433cc
```kconfig
# Awohali_STM32L433CC board configuration

# SPDX-License-Identifier: Apache-2.0

config BOARD_AWOHALI_STM32L433CC
	select SOC_STM32L433XX if BOARD_AWOHALI_STM32H745CC
```

## firmware/boards/vendor/awohali_stm32l433cc/awohali_stm32l433cc_defconfig
```kconfig
# SPDX-License-Identifier: Apache-2.0
# Copyright (c) 2020 Alexander Kozhinov <ak.alexander.kozhinov@gmail.com>
# Copyright (c) 2024 Tomas Jurena <jurena@utb.cz>

# Enable MPU
CONFIG_ARM_MPU=y

# Enable GPIO
CONFIG_GPIO=y

# Enable UART
CONFIG_SERIAL=y

# Enable I2C
CONFIG_I2C=y

# Enable CAN
CONFIG_CAN=y

# Enable SPI
CONFIG_SPI=y

# Enable clock control
CONFIG_CLOCK_CONTROL=y

# Console
CONFIG_CONSOLE=y
CONFIG_UART_CONSOLE=y

# Enable USB
CONFIG_USB_DEVICE_STACK=y
CONFIG_USB_DEVICE_INITIALIZE_AT_BOOT=y
CONFIG_CDC_ACM_DTE_RATE_CALLBACK_SUPPORT=y
```

## firmware/boards/vendor/awohali_stm32l433cc/board.yml
```yaml
board:
  name: awohali_stm32l433cc
  vendor: vendor
  socs:
    - name: stm32l433xx
```

## firmware/build/Kconfig/arch/Kconfig
```kconfig
# Load arch Kconfig descriptions.
osource "/home/deepspace/Documents/Repositories/DeepSpace00/Awohali/firmware/zephyr/arch/x86/Kconfig"
osource "/home/deepspace/Documents/Repositories/DeepSpace00/Awohali/firmware/zephyr/arch/xtensa/Kconfig"
osource "/home/deepspace/Documents/Repositories/DeepSpace00/Awohali/firmware/zephyr/arch/sparc/Kconfig"
osource "/home/deepspace/Documents/Repositories/DeepSpace00/Awohali/firmware/zephyr/arch/riscv/Kconfig"
osource "/home/deepspace/Documents/Repositories/DeepSpace00/Awohali/firmware/zephyr/arch/posix/Kconfig"
osource "/home/deepspace/Documents/Repositories/DeepSpace00/Awohali/firmware/zephyr/arch/nios2/Kconfig"
osource "/home/deepspace/Documents/Repositories/DeepSpace00/Awohali/firmware/zephyr/arch/mips/Kconfig"
osource "/home/deepspace/Documents/Repositories/DeepSpace00/Awohali/firmware/zephyr/arch/arm64/Kconfig"
osource "/home/deepspace/Documents/Repositories/DeepSpace00/Awohali/firmware/zephyr/arch/arm/Kconfig"
osource "/home/deepspace/Documents/Repositories/DeepSpace00/Awohali/firmware/zephyr/arch/arc/Kconfig"
```

## firmware/modules/drivers/bq25798/Kconfig
```kconfig
config BQ25798
    bool "BQ25798 battery charger driver"
    default n
    depends on I2C
    help
      Enable the BQ25798 MPPT battery charger driver.
```

## firmware/modules/drivers/bq76905/Kconfig
```kconfig
config BQ76905
    bool "BQ76905 battery monitor driver"
    default n
    depends on I2C
      help
        Enable the BQ76905 battery monitor driver.

      
```
