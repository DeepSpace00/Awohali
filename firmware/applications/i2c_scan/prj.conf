## CMakeLists.txt
```
#-------------------------------------------------------------------------------
# Zephyr Example Application
#
# SPDX-License-Identifier: Apache-2.0

cmake_minimum_required(VERSION 3.20.0)

set(BOARD "stm32h745i_disco/stm32h745xx/m7")

# set(BOARD "awohali_h745/stm32h745xx/m7")
set(BOARD "awohali_h745/stm32h745xx/m4")
# set(BOARD "awohali_l433/stm32l433xx")

find_package(Zephyr REQUIRED HINTS $ENV{ZEPHYR_BASE})
project(i2c_scan)

FILE(GLOB app_sources src/*.c)
target_sources(app PRIVATE ${app_sources})
```

## Kconfig
```
# SPDX-License-Identifier: Apache-2.0
#
# This file is the application Kconfig entry point. All application Kconfig
# options can be defined here or included via other application Kconfig files.
# You can browse these options using the west targets menuconfig (terminal) or
# guiconfig (GUI).

config SAMPLE_DO_OUTPUT
	bool "Do print from the main thread which can be checked"

source "Kconfig.zephyr"
```

## prj.conf
```kconfig
# SPDX-License-Identifier: Apache-2.0
#
# This file contains selected Kconfig options for the application.

CONFIG_GPIO=y
CONFIG_I2C=y

CONFIG_SHELL=y
CONFIG_I2C_SHELL=y

# CONFIG_SHELL_BACKEND_SERIAL=n

# CONFIG_USB_CDC_ACM=y
# CONFIG_UART_LINE_CTRL=y
```

## src/main.c
```c
/*
* Copyright (c) 2019 Nordic Semiconductor ASA
 *
 * SPDX-License-Identifier: Apache-2.0
 */

#include <zephyr/kernel.h>

int main(void)
{
#ifdef CONFIG_SAMPLE_DO_OUTPUT
	printk("Hello World!\n");
#endif

	return 0;
}
```
