/*
 * Copyright (c) 2025 Antmicro <www.antmicro.com>
 *
 * SPDX-License-Identifier: Apache-2.0
 */

&i2c4 {
	status = "okay";
};

&i2c3 {
	status = "okay";
};

&i2c2 {
	status = "okay";

};

&i2c1 {
	status = "okay";
};